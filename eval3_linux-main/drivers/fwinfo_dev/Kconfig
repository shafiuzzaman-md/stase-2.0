## eval3_linux-main/drivers/fwinfo_dev/Kconfig
```kconfig
config FWINFO_DEV
    tristate "Firmware Info Parsing Device"
    depends on KCHUNK
    default m
    help
      Provides a character device for parsing TLV-encoded firmware blobs.
      Performs field validation, CRC32 integrity checking, and exposes
      parsed metadata or validation errors via a per-session interface.
```

## eval3_linux-main/drivers/kcrypt/Kconfig
```kconfig
config KCRYPT
    tristate "kcrypt: AES-ECB Kernel Crypto Module using kchunk"
    depends on KCHUNK
    default m
    help
      Enables the kcrypt kernel module, which performs AES-ECB
      encryption and decryption using the in-kernel crypto API
      and a custom chunk-based allocator (kchunk). Intended for
      controlled heap allocation and crypto operation experiments.
```

## eval3_linux-main/drivers/knotes/Kconfig
```kconfig
config KNOTES
  default m
  tristate "knotes Kernel Module"
  help
    knotes implementation.
```

## eval3_linux-main/drivers/misc/kchunk/Kconfig
```kconfig
config KCHUNK
    bool "Kernel handle-based heap allocator"
    default y
    help
      Enables the kernel chunk allocator subsystem, which provides a handle-based
      fixed-size memory chunk allocator for kernel-internal use. This allocator
      supports multiple size classes, dynamic region growth, and concurrency-safe
      access via spinlocks.

      This option is intended for use by other kernel components that require
      fast and predictable memory chunk allocation behavior.

      If unsure, say Y.
```

## eval3_linux-main/drivers/misc/kheap/Kconfig
```kconfig
config KHEAP
	bool "Kernel internal heap allocator (kheap)"
	default y
	help
	  Enables the internal kernel heap allocator using an implicit free list.
	  This allocator provides basic allocation and free operations for use by
	  kernel components without using slab or vmalloc. Intended for internal-only
	  memory management.
```

## eval3_linux-main/drivers/moodpot/Kconfig
```kconfig
config MOODPOT
  tristate "MoodPot char interface"
  default m
  depends on MOODPOT_CORE && KHEAP
  help
    Char device interface for userspace interaction with moodpot devices.
```

## eval3_linux-main/drivers/moodpot_core/Kconfig
```kconfig
config MOODPOT_CORE
  default y
  bool "MoodPot core device logic"
  depends on KHEAP
  help
    Built-in core logic for moodpot simulation and pot management.
```
